## configs/f1c100s_defconfig
```kconfig
# F1C100S default configuration
CONFIG_CHIP=f1c100s
CONFIG_CPU=arm926ejs

# Boot sources
CONFIG_BOOT_SDCARD=y
CONFIG_BOOT_MMC=n
CONFIG_BOOT_SPINAND=n

# Memory
CONFIG_RAM_BASE=0x80000000
CONFIG_FEL_RAM_BASE=0x80010000

# Debug
CONFIG_LOG_LEVEL=30
```

## configs/h3_defconfig
```kconfig
# H3 default configuration
CONFIG_CHIP=h3
CONFIG_CPU=cortex-a7

# Boot sources
CONFIG_BOOT_SDCARD=y
CONFIG_BOOT_MMC=y
CONFIG_BOOT_SPINAND=n

# Memory
CONFIG_RAM_BASE=0x00000000
CONFIG_FEL_RAM_BASE=0x00008000

# Debug
CONFIG_LOG_LEVEL=30
```

## configs/t113s3_defconfig
```kconfig
# T113S3 default configuration
CONFIG_CHIP=t113s3
CONFIG_CPU=cortex-a7

# Boot sources
CONFIG_BOOT_SDCARD=y
CONFIG_BOOT_MMC=y
CONFIG_BOOT_SPINAND=y

# Memory
CONFIG_RAM_BASE=0x00020000
CONFIG_FEL_RAM_BASE=0x00030000

# Debug
CONFIG_LOG_LEVEL=30
```

## configs/v3s_defconfig
```kconfig
# V3S default configuration
CONFIG_CHIP=v3s
CONFIG_CPU=cortex-a7

# Boot sources
CONFIG_BOOT_SDCARD=y
CONFIG_BOOT_MMC=n
CONFIG_BOOT_SPINAND=n

# Memory
CONFIG_RAM_BASE=0x00000000
CONFIG_FEL_RAM_BASE=0x00010000

# Debug
CONFIG_LOG_LEVEL=30
```
